## Documentation/devicetree/bindings/display/ingenic,x2600-dpu.yaml
```yaml
# SPDX-License-Identifier: (GPL-2.0-only OR BSD-2-Clause)
%YAML 1.2
---
$id: http://devicetree.org/schemas/display/ingenic,x2600-dpu.yaml#
$schema: http://devicetree.org/meta-schemas/core.yaml#

title: Ingenic X2600 display processing unit (DPU)

maintainers:
  - Hunter Laux <hunterlaux@gmail.com>

description:
  The display controller of the Ingenic X2600. It reads framebuffers from
  memory through a composer or a simple read channel and drives a parallel
  TFT panel, or an LVDS panel through the SoC's LVDS PHY.

properties:
  compatible:
    const: ingenic,x2600-dpu

  reg:
    maxItems: 1

  interrupts:
    maxItems: 1

  clocks:
    maxItems: 1

  clock-names:
    const: lcd

  phys:
    maxItems: 1
    description: The LVDS PHY, for an LVDS panel

  phy-names:
    const: lvds

  port:
    $ref: /schemas/graph.yaml#/properties/port
    description: The display output, to the panel or bridge

required:
  - compatible
  - reg
  - interrupts
  - clocks
  - clock-names
  - port

additionalProperties: false

examples:
  - |
    #include <dt-bindings/clock/ingenic,x2600-cgu.h>

    display-controller@13050000 {
        compatible = "ingenic,x2600-dpu";
        reg = <0x13050000 0x10000>;

        interrupt-parent = <&intc>;
        interrupts = <31>;

        clocks = <&cgu X2600_CLK_LCD>;
        clock-names = "lcd";

        phys = <&dsi_dphy>;
        phy-names = "lvds";

        port {
            endpoint {
                remote-endpoint = <&panel_in>;
            };
        };
    };
...
```

## Documentation/devicetree/bindings/mips/ingenic/ingenic,x2600-ccu.yaml
```yaml
# SPDX-License-Identifier: (GPL-2.0-only OR BSD-2-Clause)
%YAML 1.2
---
$id: http://devicetree.org/schemas/mips/ingenic/ingenic,x2600-ccu.yaml#
$schema: http://devicetree.org/meta-schemas/core.yaml#

title: Ingenic X2600 core control unit (CCU)

maintainers:
  - Hunter Laux <hunterlaux@gmail.com>

description:
  The CCU of the Ingenic X2600 starts and stops the CPU cores and routes
  interrupts to them. It holds the secondary cores in reset and sets the
  address they start from, enables per core the interrupt lines of the
  interrupt controller, the OST and the mailboxes, and has one mailbox per
  core. Writing to a core's mailbox raises an interrupt on that core, on
  CPU interrupt line 3.

properties:
  compatible:
    const: ingenic,x2600-ccu

  reg:
    maxItems: 1

  interrupts:
    maxItems: 1
    description: The mailbox interrupt, a CPU interrupt line

required:
  - compatible
  - reg
  - interrupts

additionalProperties: false

examples:
  - |
    cpu-controller@12200000 {
        compatible = "ingenic,x2600-ccu";
        reg = <0x12200000 0x2000>;

        interrupt-parent = <&cpuintc>;
        interrupts = <3>;
    };
...
```

## Documentation/devicetree/bindings/phy/ingenic,phy-usb.yaml
```yaml
# SPDX-License-Identifier: (GPL-2.0-only OR BSD-2-Clause)
%YAML 1.2
---
$id: http://devicetree.org/schemas/phy/ingenic,phy-usb.yaml#
$schema: http://devicetree.org/meta-schemas/core.yaml#

title: Ingenic SoCs USB PHY

maintainers:
  - Paul Cercueil <paul@crapouillou.net>
  - 周琰杰 (Zhou Yanjie) <zhouyanjie@wanyeetech.com>

properties:
  $nodename:
    pattern: '^usb-phy@.*'

  compatible:
    enum:
      - ingenic,jz4770-phy
      - ingenic,jz4775-phy
      - ingenic,jz4780-phy
      - ingenic,x1000-phy
      - ingenic,x1830-phy
      - ingenic,x2000-phy
      - ingenic,x2600-phy

  reg:
    minItems: 1
    items:
      - description: USBPCR and the registers following it
      - description: USBPCR1, where it does not follow them
      - description: The PHY's own (analog) registers

  clocks:
    minItems: 1
    items:
      - description: The PHY's clock
      - description:
          The bus clock of the PHY's USB controller, without which the
          PHY's own registers do not respond

  clock-names:
    items:
      - const: phy
      - const: bus

  ingenic,external-vbus-detect:
    type: boolean
    description:
      VBUS is detected outside the PHY, so its VBUS comparator is powered
      down.

  vcc-supply:
    description: VCC power supply

  '#phy-cells':
    const: 0

required:
  - compatible
  - reg
  - clocks
  - vcc-supply
  - '#phy-cells'

allOf:
  - if:
      properties:
        compatible:
          contains:
            const: ingenic,x2600-phy
    then:
      properties:
        reg:
          minItems: 3
        clocks:
          minItems: 2
      required:
        - clock-names
    else:
      properties:
        reg:
          maxItems: 1
        clocks:
          maxItems: 1
        clock-names: false
        ingenic,external-vbus-detect: false

additionalProperties: false

examples:
  - |
    #include <dt-bindings/clock/ingenic,jz4770-cgu.h>
    otg_phy: usb-phy@3c {
      compatible = "ingenic,jz4770-phy";
      reg = <0x3c 0x10>;

      vcc-supply = <&vcc>;
      clocks = <&cgu JZ4770_CLK_OTG_PHY>;

      #phy-cells = <0>;
    };
  - |
    #include <dt-bindings/clock/ingenic,x2600-cgu.h>
    usb_phy: usb-phy@4c {
      compatible = "ingenic,x2600-phy";
      reg = <0x4c 0x8>, <0xe8 0x4>, <0x78400 0x100>;

      vcc-supply = <&vcc>;
      clocks = <&cgu X2600_CLK_USBPHY>, <&cgu X2600_CLK_USB>;
      clock-names = "phy", "bus";

      #phy-cells = <0>;
    };
```

## Documentation/devicetree/bindings/pwm/ingenic,x2600-pwm.yaml
```yaml
# SPDX-License-Identifier: (GPL-2.0-only OR BSD-2-Clause)
%YAML 1.2
---
$id: http://devicetree.org/schemas/pwm/ingenic,x2600-pwm.yaml#
$schema: http://devicetree.org/meta-schemas/core.yaml#

title: Ingenic X2600 PWM controller

maintainers:
  - Hunter Laux <hunterlaux@gmail.com>

description:
  The PWM controller of the Ingenic X2600, a block of its own apart from
  the TCU (see timer/ingenic,tcu.yaml). It has 16 channels, each with its
  own clock prescaler and 16-bit high and low counts; each channel can
  also be fed from DMA, and has an input capture unit.

allOf:
  - $ref: pwm.yaml#

properties:
  compatible:
    const: ingenic,x2600-pwm

  reg:
    maxItems: 1

  interrupts:
    maxItems: 1

  clocks:
    maxItems: 1

  "#pwm-cells":
    const: 3

required:
  - compatible
  - reg
  - clocks

unevaluatedProperties: false

examples:
  - |
    #include <dt-bindings/clock/ingenic,x2600-cgu.h>

    pwm@13610000 {
        compatible = "ingenic,x2600-pwm";
        reg = <0x13610000 0x1000>;

        interrupts = <20>;

        clocks = <&cgu X2600_CLK_PWM>;

        #pwm-cells = <3>;
    };
...
```

## Documentation/devicetree/bindings/timer/ingenic,x2600-ost.yaml
```yaml
# SPDX-License-Identifier: (GPL-2.0-only OR BSD-2-Clause)
%YAML 1.2
---
$id: http://devicetree.org/schemas/timer/ingenic,x2600-ost.yaml#
$schema: http://devicetree.org/meta-schemas/core.yaml#

title: Ingenic X2600 operating system timer (OST)

maintainers:
  - Hunter Laux <hunterlaux@gmail.com>

description:
  The OST of the Ingenic X2600 has a global part, one 64-bit counter shared
  by all cores, and a core part, one 32-bit compare timer per core in banks
  of 0x100 bytes. The core timers interrupt their own core directly, on CPU
  interrupt line 4.

properties:
  compatible:
    const: ingenic,x2600-ost

  reg:
    items:
      - description: Global OST, the 64-bit counter
      - description: Core OST, one 0x100-byte bank per core

  reg-names:
    items:
      - const: global
      - const: core

  clocks:
    maxItems: 1

  clock-names:
    const: ost

  interrupts:
    maxItems: 1

required:
  - compatible
  - reg
  - reg-names
  - clocks
  - clock-names
  - interrupts

additionalProperties: false

examples:
  - |
    #include <dt-bindings/clock/ingenic,x2600-cgu.h>

    timer@12000000 {
        compatible = "ingenic,x2600-ost";
        reg = <0x12000000 0x18>, <0x12100000 0x200>;
        reg-names = "global", "core";

        clocks = <&cgu X2600_CLK_OST>;
        clock-names = "ost";

        interrupt-parent = <&cpuintc>;
        interrupts = <4>;
    };
...
```

## Documentation/devicetree/bindings/watchdog/ingenic,x2600-watchdog.yaml
```yaml
# SPDX-License-Identifier: (GPL-2.0-only OR BSD-2-Clause)
%YAML 1.2
---
$id: http://devicetree.org/schemas/watchdog/ingenic,x2600-watchdog.yaml#
$schema: http://devicetree.org/meta-schemas/core.yaml#

title: Ingenic X2600 watchdog

maintainers:
  - Hunter Laux <hunterlaux@gmail.com>

description:
  The watchdog of the Ingenic X2600 has the registers of the JZ47xx TCU
  watchdog (see timer/ingenic,tcu.yaml), but in a block of its own rather
  than inside a TCU. It counts the RTC clock through its own prescaler,
  and resets the SoC when the count reaches its limit.

allOf:
  - $ref: watchdog.yaml#

properties:
  compatible:
    const: ingenic,x2600-watchdog

  reg:
    maxItems: 1

  interrupts:
    maxItems: 1

  clocks:
    items:
      - description: Register access clock
      - description: Counter input, the RTC clock

  clock-names:
    items:
      - const: bus
      - const: wdt

required:
  - compatible
  - reg
  - clocks
  - clock-names

unevaluatedProperties: false

examples:
  - |
    #include <dt-bindings/clock/ingenic,x2600-cgu.h>

    watchdog@13630000 {
        compatible = "ingenic,x2600-watchdog";
        reg = <0x13630000 0x40>;

        interrupts = <26>;

        clocks = <&cgu X2600_CLK_TCU0>, <&cgu X2600_CLK_RTC>;
        clock-names = "bus", "wdt";
    };
...
```

## arch/mips/configs/ad5x_defconfig
```kconfig
CONFIG_SYSVIPC=y
CONFIG_NO_HZ_IDLE=y
CONFIG_HIGH_RES_TIMERS=y
CONFIG_PREEMPT=y
CONFIG_IKCONFIG=y
CONFIG_IKCONFIG_PROC=y
CONFIG_EXPERT=y
CONFIG_KALLSYMS_ALL=y
CONFIG_MACH_INGENIC_SOC=y
CONFIG_X2600_FLASHFORGE_AD5X=y
CONFIG_ZBOOT_LOAD_ADDRESS=0x80f00000
CONFIG_HIGHMEM=y
CONFIG_SMP=y
CONFIG_NR_CPUS=2
CONFIG_HZ_100=y
CONFIG_MIPS_O32_FP64_SUPPORT=y
CONFIG_MIPS_CMDLINE_BUILTIN_EXTEND=y
# CONFIG_SECCOMP is not set
CONFIG_MODULES=y
CONFIG_MODULE_UNLOAD=y
CONFIG_NET=y
CONFIG_PACKET=y
CONFIG_UNIX=y
CONFIG_INET=y
CONFIG_IP_MULTICAST=y
CONFIG_CFG80211=m
CONFIG_MAC80211=m
CONFIG_DEVTMPFS=y
CONFIG_DEVTMPFS_MOUNT=y
CONFIG_NETDEVICES=y
CONFIG_STMMAC_ETH=y
CONFIG_ICPLUS_PHY=y
CONFIG_RTW88=m
CONFIG_RTW88_8821CU=m
# CONFIG_INPUT_KEYBOARD is not set
# CONFIG_INPUT_MOUSE is not set
# CONFIG_SERIO is not set
# CONFIG_VT is not set
CONFIG_SERIAL_8250=y
CONFIG_SERIAL_8250_CONSOLE=y
CONFIG_SERIAL_8250_NR_UARTS=8
CONFIG_SERIAL_8250_RUNTIME_UARTS=8
CONFIG_SERIAL_8250_INGENIC=y
CONFIG_SERIAL_OF_PLATFORM=y
CONFIG_GPIO_SYSFS=y
# CONFIG_HWMON is not set
CONFIG_REGULATOR=y
CONFIG_REGULATOR_FIXED_VOLTAGE=y
# CONFIG_HID is not set
CONFIG_USB=y
CONFIG_USB_DWC2=y
CONFIG_USB_GADGET=y
CONFIG_MMC=y
CONFIG_MMC_SDHCI=y
CONFIG_MMC_SDHCI_PLTFM=y
CONFIG_MMC_SDHCI_OF_DWCMSHC=y
CONFIG_DMADEVICES=y
CONFIG_DMA_JZ4780=y
# CONFIG_INGENIC_TIMER is not set
CONFIG_INGENIC_X2600_OST=y
# CONFIG_IOMMU_SUPPORT is not set
CONFIG_PHY_INGENIC_USB=y
CONFIG_EXT4_FS=y
CONFIG_TMPFS=y
CONFIG_SQUASHFS=y
CONFIG_SQUASHFS_LZO=y
CONFIG_SQUASHFS_XZ=y
CONFIG_PRINTK_TIME=y
CONFIG_CONSOLE_LOGLEVEL_DEFAULT=15
CONFIG_MESSAGE_LOGLEVEL_DEFAULT=7
CONFIG_MAGIC_SYSRQ=y
CONFIG_PANIC_TIMEOUT=10
# CONFIG_FTRACE is not set
CONFIG_CMDLINE_BOOL=y
CONFIG_CMDLINE="earlycon"
```

## drivers/gpu/drm/ingenic/Kconfig
```kconfig
config DRM_INGENIC
	tristate "DRM Support for Ingenic SoCs"
	depends on MIPS || COMPILE_TEST
	depends on DRM
	depends on CMA
	depends on OF
	depends on COMMON_CLK
	select DRM_BRIDGE
	select DRM_CLIENT_SELECTION
	select DRM_PANEL_BRIDGE
	select DRM_KMS_HELPER
	select DRM_DISPLAY_HELPER
	select DRM_BRIDGE_CONNECTOR
	select DRM_GEM_DMA_HELPER
	select REGMAP
	select REGMAP_MMIO
	help
	  Choose this option for DRM support for the Ingenic SoCs.

	  If M is selected the module will be called ingenic-drm.

if DRM_INGENIC

config DRM_INGENIC_IPU
	bool "IPU support for Ingenic SoCs"
	help
	  Choose this option to enable support for the IPU found in Ingenic SoCs.

	  The Image Processing Unit (IPU) will appear as a second primary plane.

config DRM_INGENIC_DW_HDMI
	tristate "Ingenic specific support for Synopsys DW HDMI"
	depends on MACH_JZ4780
	select DRM_DW_HDMI
	help
	  Choose this option to enable Synopsys DesignWare HDMI based driver.
	  If you want to enable HDMI on Ingenic JZ4780 based SoC, you should
	  select this option.

endif

config DRM_INGENIC_DPU
	tristate "DRM support for the Ingenic X2600 display processing unit"
	depends on DRM && OF && COMMON_CLK
	depends on MACH_INGENIC || COMPILE_TEST
	select DRM_BRIDGE
	select DRM_BRIDGE_CONNECTOR
	select DRM_CLIENT_SELECTION
	select DRM_DISPLAY_HELPER
	select DRM_GEM_DMA_HELPER
	select DRM_KMS_HELPER
	select DRM_PANEL_BRIDGE
	help
	  Choose this option for the display processing unit (DPU) of the
	  Ingenic X2600, which drives parallel TFT panels, and LVDS panels
	  through the SoC's LVDS PHY. The driver shows one framebuffer
	  through the DPU's simple read channel; the composer and the
	  rotator are not used.

	  If M is selected the module will be called ingenic-dpu.
```
